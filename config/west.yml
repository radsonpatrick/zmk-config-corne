## config/west.yml
```yaml
manifest:
  remotes:
    - name: zmkfirmware
      url-base: https://github.com/urob
    - name: mctechnology17
      url-base: https://github.com/mctechnology17
    - name: radsonpatrick
      url-base: https://github.com/radsonpatrick
  projects:
    - name: zmk
      remote: zmkfirmware
      revision: main
      import: app/west.yml
    - name: zmk-dongle-display
      remote: radsonpatrick
      revision: main
  self:
    path: config
```
